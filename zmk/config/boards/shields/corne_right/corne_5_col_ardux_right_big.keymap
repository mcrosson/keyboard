/*
 * Copyright (c) 2021 Mike "KemoNine" Crosson
 *
 * SPDX-License-Identifier: MIT
 */

#include <behaviors.dtsi>
#include <dt-bindings/zmk/keys.h>
#include <dt-bindings/zmk/bt.h>

// Enable ARDUX Right
#define ARDUX_RIGHT 1
#define ARDUX_BIG 1

// ARTS Row
#define KEY_A 1
#define KEY_R 2
#define KEY_T 3
#define KEY_S 4
// EYIO Row
#define KEY_E 6
#define KEY_Y 7
#define KEY_I 8
#define KEY_O 9
// Big ardux F1-12 layer keys for combo
#define KEY_F_TOP 0
#define KEY_F_BOTTOM 5
// Alt-F4 combo key positions
#define KEY_ALT_F4_1 11
#define KEY_ALT_F4_2 12

// Define Offsets
#define LEADING_NONES NONE(0,0,1)
#define MIDDLE_NONES NONE(0, 0, 1)
#define TRAILING_NONES NONE(0, 0, 8)
#define BIG_LEADING_NONES NONE(0, 0, 0)
#define BIG_BETWEEN_ROW_ONE_TWO_NONES NONE(0, 0, 0)
#define BIG_BETWEEN_ROW_TWO_THREE_NONES NONE(0, 0, 0)
#define BIG_BETWEEN_ROW_THREE_THUMBS NONE(0, 0, 0)
#define BIG_TRAILING_NONES NONE(0, 0, 0)

// Include main ardux.io keymap
#include "../../../ardux.dtsi"
