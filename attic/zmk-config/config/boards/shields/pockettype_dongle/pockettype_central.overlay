/*
 * Copyright (c) 2020 The ZMK Contributors
 *
 * SPDX-License-Identifier: MIT
 */

#include <dt-bindings/zmk/matrix_transform.h>

#include "pockettype_dongle.overlay"

/ {
	kscan0: kscan {
		compatible = "zmk,kscan-gpio-direct";

		label = "KSCAN";

		input-gpios
			= <&gpio0 18 (GPIO_PULL_UP | GPIO_ACTIVE_LOW)>
			;
	};

	chosen {
		zmk,kscan = &kscan0;
		zmk,matrix_transform = &default_transform;
	};
};
