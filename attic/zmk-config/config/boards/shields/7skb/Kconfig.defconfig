## attic/zmk-config/config/boards/shields/7skb/Kconfig.defconfig
```kconfig
if SHIELD_7SKB_LEFT

config ZMK_KEYBOARD_NAME
	default "7skb"

config ZMK_SPLIT_BLE_ROLE_CENTRAL
	default y

endif

if SHIELD_7SKB_RIGHT

config ZMK_KEYBOARD_NAME
	default "7skb Right"
	
endif

if SHIELD_7SKB_LEFT || SHIELD_7SKB_RIGHT

config ZMK_SPLIT
	default y

endif
```

## attic/zmk-config/config/boards/shields/7skb/Kconfig.shield
```kconfig
# Copyright (c) 2021 The ZMK Contributors
# SPDX-License-Identifier: MIT

config SHIELD_7SKB_LEFT
	def_bool $(shields_list_contains,7skb_left)

config SHIELD_7SKB_RIGHT
	def_bool $(shields_list_contains,7skb_right)
```

## attic/zmk-config/config/boards/shields/navi10/Kconfig.defconfig
```kconfig
# Copyright (c) 2021 The ZMK Contributors
# SPDX-License-Identifier: MIT

if SHIELD_NAVI10

config ZMK_KEYBOARD_NAME
    default "navi10"

endif
```

## keyboards/zmk-config/config/boards/shields/pockettype_dongle/Kconfig.defconfig
```kconfig
# Copyright (c) 2020 The ZMK Contributors
# SPDX-License-Identifier: MIT

if POCKETTYPE_CENTRAL

config ZMK_KEYBOARD_NAME
	default "Pockettype Dongle"

config ZMK_SPLIT_BLE_ROLE_CENTRAL
	default y

endif

if POCKETTYPE_PERIPHERAL

config ZMK_KEYBOARD_NAME
	default "Pockettype"

endif

if POCKETTYPE_CENTRAL || POCKETTYPE_PERIPHERAL

config ZMK_SPLIT
	default y

config USB
	default y
 
endif
```

## keyboards/zmk-config/config/boards/shields/pockettype_dongle/Kconfig.shield
```kconfig
# Copyright (c) 2020 The ZMK Contributors
# SPDX-License-Identifier: MIT

config POCKETTYPE_CENTRAL
	def_bool $(shields_list_contains,pockettype_central)

config POCKETTYPE_PERIPHERAL
	def_bool $(shields_list_contains,pockettype_peripheral)
```

## zmk-config/config/boards/arm/sparkfun_pro_nrf52840_mini/Kconfig.board
```kconfig
# Maker Diary nrf52840 M.2 board configuration
#
# Copyright (c) 2020 The ZMK Contributors
# SPDX-License-Identifier: MIT
#

config BOARD_SPARKFUN_PRO_NRF52840_MINI
	bool "sparkfun_pro_nrf52840_mini"
	depends on SOC_NRF52840_QIAA
```

## zmk-config/config/boards/arm/sparkfun_pro_nrf52840_mini/Kconfig.defconfig
```kconfig
#
# Copyright (c) 2020 The ZMK Contributors
# SPDX-License-Identifier: MIT
#

if BOARD_SPARKFUN_PRO_NRF52840_MINI

config BOARD
	default "sparkfun_pro_nrf52840_mini"

if USB

config USB_NRFX
	default y

config USB_DEVICE_STACK
	default y

endif # USB

config BT_CTLR
	default BT

config ZMK_BLE
	default y

config ZMK_USB
	default y

endif # BOARD_SPARKFUN_PRO_NRF52840_MINI
```

## zmk-config/config/boards/shields/artsey_dev/Kconfig.defconfig
```kconfig
# Copyright (c) 2020 The ZMK Contributors
# SPDX-License-Identifier: MIT

if SHIELD_ARTSEY_DEV

config ZMK_KEYBOARD_NAME
    default "ARTSEY DEV"

endif
```

## zmk-config/config/boards/shields/artsey_dev/Kconfig.shield
```kconfig
# Copyright (c) 2020 The ZMK Contributors
# SPDX-License-Identifier: MIT

config SHIELD_ARTSEY_DEV
	def_bool $(shields_list_contains,artsey_dev)
```

## zmk-config/config/boards/shields/azarashi64/Kconfig.defconfig
```kconfig
# Copyright (c) 2020 The ZMK Contributors
# SPDX-License-Identifier: MIT

if SHIELD_AZARASHI64_LEFT

config ZMK_KEYBOARD_NAME
    default "Azarashi64 Left"

config ZMK_SPLIT_BLE_ROLE_CENTRAL
	default y

endif

if SHIELD_AZARASHI64_RIGHT

config ZMK_KEYBOARD_NAME
    default "Azarashi64 Right"

config USB
	default y

endif

if SHIELD_AZARASHI64_LEFT || SHIELD_AZARASHI64_RIGHT

config ZMK_SPLIT
	default y

endif
```

## zmk-config/config/boards/shields/mdk_dongle/Kconfig.defconfig
```kconfig
# Copyright (c) 2020 The ZMK Contributors
# SPDX-License-Identifier: MIT

if SHIELD_MDK_DONGLE

config ZMK_KEYBOARD_NAME
    default "MDK Dongle"

endif
```

## zmk-config/config/boards/shields/mdk_dongle/Kconfig.shield
```kconfig
# Copyright (c) 2020 The ZMK Contributors
# SPDX-License-Identifier: MIT

config SHIELD_MDK_DONGLE
	def_bool $(shields_list_contains,mdk_dongle)
```

## zmk-config/config/boards/shields/navi10/Kconfig.shield
```kconfig
# Copyright (c) 2021 The ZMK Contributors
# SPDX-License-Identifier: MIT

config SHIELD_NAVI10
	def_bool $(shields_list_contains,navi10)
```

## zmk-config/config/boards/shields/steno_left_lily58/Kconfig.shield
```kconfig
# Copyright (c) 2020 The ZMK Contributors
# SPDX-License-Identifier: MIT

config SHIELD_STENO_LEFT_LILY58
	def_bool $(shields_list_contains,steno_left_lily58)
```

## zmk-config/config/boards/shields/steno_right_lily58/Kconfig.shield
```kconfig
# Copyright (c) 2020 The ZMK Contributors
# SPDX-License-Identifier: MIT

config SHIELD_STENO_RIGHT_LILY58
	def_bool $(shields_list_contains,steno_right_lily58)
```

## zmk-config/config/boards/shields/tidbit_artsey_left/Kconfig.shield
```kconfig
# Copyright (c) 2020 The ZMK Contributors
# SPDX-License-Identifier: MIT

config SHIELD_TIDBIT_ARTSEY_LEFT
	def_bool $(shields_list_contains,tidbit_artsey_left)
```

## zmk/app/boards/shields/tidbit/Kconfig.defconfig
```kconfig
# Copyright (c) 2020 The ZMK Contributors
# SPDX-License-Identifier: MIT

if SHIELD_TIDBIT

config ZMK_KEYBOARD_NAME
	default "tidbit"

endif
```

## zmk/config/boards/shields/corne_left/Kconfig.defconfig
```kconfig
if SHIELD_CORNE_ARDUX_LEFT || SHIELD_CORNE_5_COL_ARDUX_LEFT || SHIELD_CORNE_5_COL_ARDUX_LEFT_BIG

config ZMK_KEYBOARD_NAME
	default "ARDUX L"

config I2C
	default n

config SSD1306
	default n

endif
```

## zmk/config/boards/shields/corne_left/Kconfig.shield
```kconfig
# Copyright (c) 2021 Mike "KemoNine" Crosson
# SPDX-License-Identifier: MIT

config SHIELD_CORNE_5_COL_ARDUX_LEFT_BIG
	def_bool $(shields_list_contains,corne_5_col_ardux_left_big)
```

## zmk/config/boards/shields/corne_right/Kconfig.defconfig
```kconfig
if SHIELD_CORNE_ARDUX_RIGHT || SHIELD_CORNE_5_COL_ARDUX_RIGHT || SHIELD_CORNE_5_COL_ARDUX_RIGHT_BIG

config ZMK_KEYBOARD_NAME
	default "ARDUX R"

config I2C
	default n

config SSD1306
	default n

endif
```

## zmk/config/boards/shields/corne_right/Kconfig.shield
```kconfig
# Copyright (c) 2021 Mike "KemoNine" Crosson
# SPDX-License-Identifier: MIT

config SHIELD_CORNE_5_COL_ARDUX_RIGHT_BIG
	def_bool $(shields_list_contains,corne_5_col_ardux_right_big)
```
